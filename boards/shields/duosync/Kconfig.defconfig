## boards/shields/duosync/Kconfig.defconfig
```kconfig
if SHIELD_DUOSYNC_LEFT

config ZMK_KEYBOARD_NAME
    default "Duosync BLE"

config ZMK_SPLIT_ROLE_CENTRAL
    default y

endif

if SHIELD_DUOSYNC_LEFT || SHIELD_DUOSYNC_RIGHT

config ZMK_SPLIT
    default y

config ZMK_BLE
    default y

config ZMK_USB
	default n
endif
```

## boards/shields/duosync/Kconfig.shield
```kconfig
config SHIELD_DUOSYNC_LEFT
    def_bool $(shields_list_contains,duosync_left)

config SHIELD_DUOSYNC_RIGHT
    def_bool $(shields_list_contains,duosync_right)
```
